## Documentation/devicetree/bindings/mtd/jedec,spi-nor.txt
```
* MTD SPI driver for ST M25Pxx (and similar) serial flash chips

Required properties:
- #address-cells, #size-cells : Must be present if the device has sub-nodes
  representing partitions.
- compatible : May include a device-specific string consisting of the
               manufacturer and name of the chip. Bear in mind the DT binding
               is not Linux-only, but in case of Linux, see the "m25p_ids"
               table in drivers/mtd/devices/m25p80.c for the list of supported
               chips.
               Must also include "jedec,spi-nor" for any SPI NOR flash that can
               be identified by the JEDEC READ ID opcode (0x9F).
- reg : Chip-Select number
- spi-max-frequency : Maximum frequency of the SPI bus the chip can operate at

Optional properties:
- m25p,fast-read : Use the "fast read" opcode to read data from the chip instead
                   of the usual "read" opcode. This opcode is not supported by
                   all chips and support for it can not be detected at runtime.
                   Refer to your chips' datasheet to check if this is supported
                   by your chip.
- broken-flash-reset : Some flash devices utilize stateful addressing modes
		   (e.g., for 32-bit addressing) which need to be managed
		   carefully by a system. Because these sorts of flash don't
		   have a standardized software reset command, and because some
		   systems don't toggle the flash RESET# pin upon system reset
		   (if the pin even exists at all), there are systems which
		   cannot reboot properly if the flash is left in the "wrong"
		   state. This boolean flag can be used on such systems, to
		   denote the absence of a reliable reset mechanism.

Example:

	flash: m25p80@0 {
		#address-cells = <1>;
		#size-cells = <1>;
		compatible = "spansion,m25p80", "jedec,spi-nor";
		reg = <0>;
		spi-max-frequency = <40000000>;
		m25p,fast-read;
	};
```
